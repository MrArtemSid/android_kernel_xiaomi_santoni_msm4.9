/ {
	reserved-memory {
		other_ext_mem: other_ext_region@0 {
			/delete-property/ reg;
			reg = <0x0 0x84A00000 0x0 0x1E00000>;
		};
		pstore_reserve_mem_region@0 {
			compatible = "removed-dma-pool";
			no-map;
			reg = <0x0 0x9ff00000 0x0 0x300000>;
		};
	};
};
